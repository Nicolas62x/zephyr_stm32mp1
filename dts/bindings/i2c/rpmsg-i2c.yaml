## dts/bindings/i2c/rpmsg-i2c.yaml
```yaml
# Copyright (c) 2019 ST MICROELECTRONIC
# SPDX-License-Identifier: Apache-2.0

description: Support of virtual I2C over RPMsg

compatible: "rpmsg-i2c"

include: i2c-controller.yaml
```
